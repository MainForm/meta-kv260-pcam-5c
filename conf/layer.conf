## conf/machine/include/zynqmp-kv260-sdt-full/zynqmp-kv260-sdt-full-cortexa53-fsbl-features.conf
```bitbake
MACHINE_FEATURES = "avbuf axipmon axivdma clockps common coresightps-dcc csi csudma ddrcpsu dpdma dphy dppsu emacps gpio gpiops iic iicps ipipsu mipicsiss qspipsu resetps rtcpsu scugic sdps spips sysmonpsu ttcps uartps usbpsu video-common wdtps zdma"
```

## conf/machine/include/zynqmp-kv260-sdt-full/zynqmp-kv260-sdt-full-microblaze-pmu-features.conf
```bitbake
MACHINE_FEATURES = "avbuf axipmon axivdma clockps common csi csudma ddrcpsu dpdma dphy dppsu emacps gpio gpiops iic iicps ipipsu mipicsiss qspipsu resetps rtcpsu sdps spips sysmonpsu ttcps uartps usbpsu video-common wdtps zdma"
```

## conf/machine/include/zynqmp-kv260-sdt-full/zynqmp-kv260-sdt-full-microblaze-pmu-libxil.conf
```bitbake
PACKAGECONFIG[avbuf] = "${RECIPE_SYSROOT}/usr/lib/libavbuf.a,,avbuf,,"
PACKAGECONFIG[axipmon] = "${RECIPE_SYSROOT}/usr/lib/libaxipmon.a,,axipmon,,"
PACKAGECONFIG[axivdma] = "${RECIPE_SYSROOT}/usr/lib/libaxivdma.a,,axivdma,,"
PACKAGECONFIG[clockps] = "${RECIPE_SYSROOT}/usr/lib/libclockps.a,,clockps,,"
PACKAGECONFIG[common] = "${RECIPE_SYSROOT}/usr/lib/libcommon.a,,common,,"
PACKAGECONFIG[csi] = "${RECIPE_SYSROOT}/usr/lib/libcsi.a,,csi,,"
PACKAGECONFIG[csudma] = "${RECIPE_SYSROOT}/usr/lib/libcsudma.a,,csudma,,"
PACKAGECONFIG[ddrcpsu] = "${RECIPE_SYSROOT}/usr/lib/libddrcpsu.a,,ddrcpsu,,"
PACKAGECONFIG[dpdma] = "${RECIPE_SYSROOT}/usr/lib/libdpdma.a,,dpdma,,"
PACKAGECONFIG[dphy] = "${RECIPE_SYSROOT}/usr/lib/libdphy.a,,dphy,,"
PACKAGECONFIG[dppsu] = "${RECIPE_SYSROOT}/usr/lib/libdppsu.a,,dppsu,,"
PACKAGECONFIG[emacps] = "${RECIPE_SYSROOT}/usr/lib/libemacps.a,,emacps,,"
PACKAGECONFIG[gpio] = "${RECIPE_SYSROOT}/usr/lib/libgpio.a,,gpio,,"
PACKAGECONFIG[gpiops] = "${RECIPE_SYSROOT}/usr/lib/libgpiops.a,,gpiops,,"
PACKAGECONFIG[iic] = "${RECIPE_SYSROOT}/usr/lib/libiic.a,,iic,,"
PACKAGECONFIG[iicps] = "${RECIPE_SYSROOT}/usr/lib/libiicps.a,,iicps,,"
PACKAGECONFIG[ipipsu] = "${RECIPE_SYSROOT}/usr/lib/libipipsu.a,,ipipsu,,"
PACKAGECONFIG[mipicsiss] = "${RECIPE_SYSROOT}/usr/lib/libmipicsiss.a,,mipicsiss,,"
PACKAGECONFIG[qspipsu] = "${RECIPE_SYSROOT}/usr/lib/libqspipsu.a,,qspipsu,,"
PACKAGECONFIG[resetps] = "${RECIPE_SYSROOT}/usr/lib/libresetps.a,,resetps,,"
PACKAGECONFIG[rtcpsu] = "${RECIPE_SYSROOT}/usr/lib/librtcpsu.a,,rtcpsu,,"
PACKAGECONFIG[sdps] = "${RECIPE_SYSROOT}/usr/lib/libsdps.a,,sdps,,"
PACKAGECONFIG[spips] = "${RECIPE_SYSROOT}/usr/lib/libspips.a,,spips,,"
PACKAGECONFIG[sysmonpsu] = "${RECIPE_SYSROOT}/usr/lib/libsysmonpsu.a,,sysmonpsu,,"
PACKAGECONFIG[ttcps] = "${RECIPE_SYSROOT}/usr/lib/libttcps.a,,ttcps,,"
PACKAGECONFIG[uartps] = "${RECIPE_SYSROOT}/usr/lib/libuartps.a,,uartps,,"
PACKAGECONFIG[usbpsu] = "${RECIPE_SYSROOT}/usr/lib/libusbpsu.a,,usbpsu,,"
PACKAGECONFIG[video-common] = "${RECIPE_SYSROOT}/usr/lib/libvideo_common.a,,video-common,,"
PACKAGECONFIG[wdtps] = "${RECIPE_SYSROOT}/usr/lib/libwdtps.a,,wdtps,,"
PACKAGECONFIG[zdma] = "${RECIPE_SYSROOT}/usr/lib/libzdma.a,,zdma,,"
```
